//http://api.openweathermap.org/data/2.5/weather?zip=10514&APPID=e2ec81f9a4679b57c3e85d79510132f2
#include <Adafruit_NeoPixel.h>
#include <ArduinoJson.h>
#include <SPI.h>
#include <WiFi101.h>
#include <Wire.h>
#include <Adafruit_GFX.h>
#include <Adafruit_SSD1306.h>

// If using software SPI (the default case):
#define OLED_MOSI   9
#define OLED_CLK   10
#define OLED_DC    11
#define OLED_CS    12
#define OLED_RESET 13
Adafruit_SSD1306 display(OLED_MOSI, OLED_CLK, OLED_DC, OLED_RESET, OLED_CS);

#define NUMFLAKES 10
#define XPOS 0
#define YPOS 1
#define DELTAY 2

char ssid[] = "your_wifi_here"; //  your network SSID (name)
char pass[] = "hunter2";//  your network PASSWORD ()

//open weather map api key
String apiKey = "your_api_key_here";
//the city you want the weather for
String location = "Chappaqua,US";
String locationToPrint = location.substring(0, location.length() - 3);
int status = WL_IDLE_STATUS;

char server[] = "api.openweathermap.org";
WiFiClient client;

int numLights;
uint32_t color;
#define NEOPIXEL 6
#define NUMPIXELS 24
Adafruit_NeoPixel pixels = Adafruit_NeoPixel(NUMPIXELS, NEOPIXEL, NEO_GRB + NEO_KHZ800);

/////////////////////////////////////////////////////////////////////////////////////////////////
/////////////////////////////////////////////////////////////////////////////////////////////////
const int iconDim = 64;

// 'exclamation', 64x64px
const unsigned char exclamation [] PROGMEM = {
  0x00, 0x00, 0x00, 0x00, 0x00, 0x00, 0x00, 0x00, 0x00, 0x00, 0x00, 0x00, 0x00, 0x00, 0x00, 0x00,
  0x00, 0x00, 0x00, 0x00, 0x00, 0x00, 0x00, 0x00, 0x00, 0x00, 0x00, 0x00, 0x00, 0x00, 0x00, 0x00,
  0x00, 0x00, 0x00, 0x00, 0x00, 0x00, 0x00, 0x00, 0x00, 0x00, 0x00, 0x00, 0x00, 0x00, 0x00, 0x00,
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  0x00, 0x00, 0x00, 0x00, 0x00, 0x00, 0x00, 0x00, 0x00, 0x00, 0x00, 0x00, 0x00, 0x00, 0x00, 0x00
};


// 'wi-cloud', 64x64px
const unsigned char cloud[] PROGMEM = {
  0x00, 0x00, 0x00, 0x00, 0x00, 0x00, 0x00, 0x00, 0x00, 0x00, 0x00, 0x00, 0x00, 0x00, 0x00, 0x00,
  0x00, 0x00, 0x00, 0x00, 0x00, 0x00, 0x00, 0x00, 0x00, 0x00, 0x00, 0x00, 0x00, 0x00, 0x00, 0x00,
  0x00, 0x00, 0x00, 0x00, 0x00, 0x00, 0x00, 0x00, 0x00, 0x00, 0x00, 0x00, 0x00, 0x00, 0x00, 0x00,
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  0x00, 0x00, 0x00, 0x00, 0x00, 0x00, 0x00, 0x00, 0x00, 0x00, 0x00, 0x00, 0x00, 0x00, 0x00, 0x00
};

// 'wi-day-sunny, 64x64px
const unsigned char sunny[] PROGMEM = {
  0x00, 0x00, 0x00, 0x00, 0x00, 0x00, 0x00, 0x00, 0x00, 0x00, 0x00, 0x00, 0x00, 0x00, 0x00, 0x00,
  0x00, 0x00, 0x00, 0x00, 0x00, 0x00, 0x00, 0x00, 0x00, 0x00, 0x00, 0x00, 0x00, 0x00, 0x00, 0x00,
  0x00, 0x00, 0x00, 0x00, 0x00, 0x00, 0x00, 0x00, 0x00, 0x00, 0x00, 0x00, 0x00, 0x00, 0x00, 0x00,
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  0x00, 0x00, 0x00, 0x00, 0x00, 0x00, 0x00, 0x00, 0x00, 0x00, 0x00, 0x00, 0x00, 0x00, 0x00, 0x00,
};

// 'wi-fog', 64x64px
const unsigned char fog[] PROGMEM = {
  0x00, 0x00, 0x00, 0x00, 0x00, 0x00, 0x00, 0x00, 0x00, 0x00, 0x00, 0x00, 0x00, 0x00, 0x00, 0x00,
  0x00, 0x00, 0x00, 0x00, 0x00, 0x00, 0x00, 0x00, 0x00, 0x00, 0x00, 0x00, 0x00, 0x00, 0x00, 0x00,
  0x00, 0x00, 0x00, 0x00, 0x00, 0x00, 0x00, 0x00, 0x00, 0x00, 0x00, 0x00, 0x00, 0x00, 0x00, 0x00,
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  0x00, 0x00, 0x00, 0x00, 0x00, 0x00, 0x00, 0x00, 0x00, 0x00, 0x00, 0x00, 0x00, 0x00, 0x00, 0x00
};

// 'wi-night-clear', 64x64px
const unsigned char clearNight[] PROGMEM = {
  0x00, 0x00, 0x00, 0x00, 0x00, 0x00, 0x00, 0x00, 0x00, 0x00, 0x00, 0x00, 0x00, 0x00, 0x00, 0x00,
  0x00, 0x00, 0x00, 0x00, 0x00, 0x00, 0x00, 0x00, 0x00, 0x00, 0x00, 0x00, 0x00, 0x00, 0x00, 0x00,
  0x00, 0x00, 0x00, 0x00, 0x00, 0x00, 0x00, 0x00, 0x00, 0x00, 0x00, 0x00, 0x00, 0x00, 0x00, 0x00,
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  0x00, 0x00, 0x00, 0x00, 0x00, 0x00, 0x00, 0x00, 0x00, 0x00, 0x00, 0x00, 0x00, 0x00, 0x00, 0x00
};

// 'wi-rain', 64x64px
const unsigned char rain[] PROGMEM = {
  0x00, 0x00, 0x00, 0x00, 0x00, 0x00, 0x00, 0x00, 0x00, 0x00, 0x00, 0x00, 0x00, 0x00, 0x00, 0x00,
  0x00, 0x00, 0x00, 0x00, 0x00, 0x00, 0x00, 0x00, 0x00, 0x00, 0x00, 0x00, 0x00, 0x00, 0x00, 0x00,
  0x00, 0x00, 0x00, 0x00, 0x00, 0x00, 0x00, 0x00, 0x00, 0x00, 0x00, 0x00, 0x00, 0x00, 0x00, 0x00,
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  0x00, 0x00, 0x00, 0x00, 0x00, 0x00, 0x00, 0x00, 0x00, 0x00, 0x00, 0x00, 0x00, 0x00, 0x00, 0x00
};

// 'wi-snow', 64x64px
const unsigned char snow[] PROGMEM = {
  0x00, 0x00, 0x00, 0x00, 0x00, 0x00, 0x00, 0x00, 0x00, 0x00, 0x00, 0x00, 0x00, 0x00, 0x00, 0x00,
  0x00, 0x00, 0x00, 0x00, 0x00, 0x00, 0x00, 0x00, 0x00, 0x00, 0x00, 0x00, 0x00, 0x00, 0x00, 0x00,
  0x00, 0x00, 0x00, 0x00, 0x00, 0x00, 0x00, 0x00, 0x00, 0x00, 0x00, 0x00, 0x00, 0x00, 0x00, 0x00,
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  0x00, 0x00, 0x00, 0x00, 0x00, 0x00, 0x00, 0x00, 0x00, 0x00, 0x00, 0x00, 0x00, 0x00, 0x00, 0x00
};

// 'wi-windy', 64x64px
const unsigned char windy[] PROGMEM = {
  0x00, 0x00, 0x00, 0x00, 0x00, 0x00, 0x00, 0x00, 0x00, 0x00, 0x00, 0x00, 0x00, 0x00, 0x00, 0x00,
  0x00, 0x00, 0x00, 0x00, 0x00, 0x00, 0x00, 0x00, 0x00, 0x00, 0x00, 0x00, 0x00, 0x00, 0x00, 0x00,
  0x00, 0x00, 0x00, 0x00, 0x00, 0x00, 0x00, 0x00, 0x00, 0x00, 0x00, 0x00, 0x00, 0x00, 0x00, 0x00,
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  0x00, 0x00, 0x00, 0x00, 0x00, 0x00, 0x00, 0x00, 0x00, 0x00, 0x00, 0x00, 0x00, 0x00, 0x00, 0x00
};

// 'wi-thunderstorm, 64x64px
const unsigned char thunderstorm [] PROGMEM = {
  0x00, 0x00, 0x00, 0x00, 0x00, 0x00, 0x00, 0x00, 0x00, 0x00, 0x00, 0x00, 0x00, 0x00, 0x00, 0x00,
  0x00, 0x00, 0x00, 0x00, 0x00, 0x00, 0x00, 0x00, 0x00, 0x00, 0x00, 0x00, 0x00, 0x00, 0x00, 0x00,
  0x00, 0x00, 0x00, 0x00, 0x00, 0x00, 0x00, 0x00, 0x00, 0x00, 0x00, 0x00, 0x00, 0x00, 0x00, 0x00,
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  0x00, 0x00, 0x00, 0x00, 0x00, 0x00, 0x00, 0x00, 0x00, 0x00, 0x00, 0x00, 0x00, 0x00, 0x00, 0x00,
};
/////////////////////////////////////////////////////////////////////////////////////////////////
/////////////////////////////////////////////////////////////////////////////////////////////////

void setup() {

  display.begin(SSD1306_SWITCHCAPVCC);
  display.display();
  delay(1000);
  display.clearDisplay();

  //Initialize serial and wait for port to open:
  Serial.begin(9600);

  // attempt to connect to Wifi network:
  while (status != WL_CONNECTED) {
    Serial.print("Attempting to connect to SSID: ");
    Serial.println(ssid);
    //status = WiFi.begin(ssid);
    //use the line below if your network is protected by wpa password
    status = WiFi.begin(ssid, pass);
    // wait 10 seconds for connection:
    delay(1000);
  }
  Serial.println("Connected to wifi");
  pixels.begin(); //begin neopixel stuff
  pixels.show();
}

void loop() {
  getWeather();
  delay(1000 * 60 * 10); //wait ten minutes
}

void getWeather() {
  Serial.println("\nStarting connection to server..."); //conect to internet and get data
  // if you get a connection, report back via serial:
  if (client.connect(server, 80)) {
    Serial.println("connected to server");
    // Make a HTTP request:
    client.print("GET /data/2.5/weather?");
    client.print("q=" + location);
    client.print("&appid=" + apiKey);
    client.print("&cnt=3");
    client.println("&units=imperial");
    client.println("Host: api.openweathermap.org");
    client.println("Connection: close");
    client.println();
  } else {
    Serial.println("unable to connect");
  }

  delay(1000);
  String line = "";
  while (client.connected()) {
    line = client.readStringUntil('\n');
    //Serial.println(line);
    Serial.println("parsingValues");
    //create a json buffer where to store the json data

    StaticJsonBuffer<5000> jsonBuffer;
    JsonObject& root = jsonBuffer.parseObject(line);
    if (!root.success()) {
      Serial.println("parseObject() failed");
      return;
    }

    //get the data from the json tree
    float temp = root["main"]["temp"];
    String weather = root["weather"][0]["main"];
    //String description = root["weather"][0]["description"];
    unsigned long currentTime = root["dt"];
    unsigned long sunrise = root["sys"]["sunrise"];
    unsigned long sunset = root["sys"]["sunset"];

    Serial.println(temp);
    Serial.println(weather);
    Serial.println(currentTime);
    Serial.println(sunrise);
    Serial.println(sunset);

    int tempToDisplay = (int)(temp + 0.5f); //rounding

    ring(tempToDisplay);
    screenOutput(tempToDisplay, weather, currentTime, sunrise, sunset);

  }
}

void screenOutput(int tempToDisplay, String weather, unsigned long currentTime, unsigned long sunrise, unsigned long sunset) {
  display.fillScreen(BLACK); //clear the display
  display.display();

  if (weather.equalsIgnoreCase("Drizzle") || weather.equalsIgnoreCase("Rain")) {
    display.drawBitmap(0, 0, rain, iconDim, iconDim, WHITE);
  }
  else if (weather.equalsIgnoreCase("Thunderstorm")) {
    display.drawBitmap(0, 0, thunderstorm, iconDim, iconDim, WHITE);
  }
  else if (weather.equalsIgnoreCase("Clouds")) {
    display.drawBitmap(0, 0, cloud, iconDim, iconDim, WHITE);
  }
  else if (weather.equalsIgnoreCase("Snow")) {
    display.drawBitmap(0, 0, snow, iconDim, iconDim, WHITE);
  }
  else if ((weather.equalsIgnoreCase("Atmosphere")) || (weather.equalsIgnoreCase("Mist"))) {
    display.drawBitmap(0, 0, fog, iconDim, iconDim, WHITE);
  }
  else if (weather.equalsIgnoreCase("Clear")) { //display different icons depending whether it's day or night
    if ((currentTime > sunrise ) && (currentTime < sunset)) {
      display.drawBitmap(0, 0, sunny, iconDim, iconDim, WHITE);
    }
    else {
      display.drawBitmap(0, 0, clearNight, iconDim, iconDim, WHITE);
    }
  }
  else if (weather.equalsIgnoreCase("Clouds")) {
    display.drawBitmap(0, 0, cloud, iconDim, iconDim, WHITE);
  }
  else if (weather.equalsIgnoreCase("Extreme")) {
    display.drawBitmap(0, 0, exclamation, iconDim, iconDim, WHITE);
  }
  else if (weather.equalsIgnoreCase("Additional")) {
    display.drawBitmap(0, 0, windy, iconDim, iconDim, WHITE);
  }


  display.drawLine(64, 16, 64, 48, WHITE);

  display.setCursor(80, 24); //print out temperature
  display.setTextSize(2);
  display.setTextColor(WHITE);
  display.print(tempToDisplay);

  //print out description
  display.setTextSize(1);
  display.setCursor(0, 56);
  display.print(locationToPrint);
  
  if (weather.equalsIgnoreCase("Thunderstorm")) {
    display.setCursor(80, 48);
    display.print("Thunder");
    display.setCursor(80, 56);
    display.print("storm");
  }
  else {
    display.setCursor(80, 56);
    display.print(weather); //thunderstorm and atmosphere won't fit. If that's the weather, change the output.
  }
  display.display();

}

void ring(int temp) {
  for (int i = 0; i < NUMPIXELS; i++) { //clear the neopixels
    pixels.Color(i, 0, 0, 0);
  }
  pixels.show();

  if (temp > 80) { //determine what color the neopixels will be
    color = pixels.Color(32, 0, 0); //red
  }
  else if (temp > 60) {
    color = pixels.Color(0, 32, 0); //light green
  }
  else if (temp > 32) {
    color = pixels.Color(32, 32, 0); //yellow
  }
  else {
    color = pixels.Color(0, 32, 32); //cyan
  }

  numLights = ((int) (temp / 4)); //each LED represents 4 degrees Farenheit
  if (numLights > NUMPIXELS) { //don't let it exceed number of pixels
    numLights = NUMPIXELS;
  }
  if (numLights < 1) { //can't light up pixel -1.
    numLights = 1;
  }

  for (int i = 0; i < numLights; i++) { //light up the LEDs
    pixels.setPixelColor(i, color);
  }
  pixels.show();
}
